## base_external/package/aesd-char/Config.in
```kconfig
config BR2_PACKAGE_AESD_CHAR
	bool "AESD_CHAR"
	help
	  Includes the driver load and unload files in the kernel image.
	  Used to understand buildroot external trees and package builds.
```

## base_external/package/ldd/Config.in
```kconfig
config BR2_PACKAGE_LDD
	bool "LDD"
	help
	  Includes the driver load and unload files in the kernel image.
	  Used to understand buildroot external trees and package builds.
```
